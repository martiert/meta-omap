## conf/layer.conf
```bitbake
# We have a conf and classes directory, append to BBPATH
BBPATH .= ":${LAYERDIR}"

# We have a recipes directory, add to BBFILES
BBFILES += "${LAYERDIR}/recipes*/*/*.bb ${LAYERDIR}/recipes*/*/*.bbappend"

BBFILE_COLLECTIONS += "meta-omap"
BBFILE_PATTERN_meta-omap := "^${LAYERDIR}/"
BBFILE_PRIORITY_meta-omap = "6"
```

## conf/machine/include/omap4.inc
```bitbake
SOC_FAMILY = "omap4"

require conf/machine/include/soc-family.inc
require conf/machine/include/tune-cortexa9.inc

PREFERRED_PROVIDER_virtual/kernel = "linux-omap"
PREFERRED_VERSION_virtual/kernel = "3.4%"
PREFERRED_PROVIDER_virtual/bootloader = "u-boot"
PREFERRED_VERSION_u-boot = "v2013.01%"

PREFERRED_PROVIDER_virtual/egl = "pvr-omap4"
PREFERRED_PROVIDER_virtual/libgles1 = "pvr-omap4"
PREFERRED_PROVIDER_virtual/libgles2 = "pvr-omap4"

PREFERRED_PROVIDER_virtual/xserver = "xserver-xorg"
XSERVER = "xserver-xorg \
           xserver-xorg-module-exa \
           xf86-input-evdev \
           pvr-omap4 \
           pvr-omap4-dkms \
"

# Increase this everytime you change something in the kernel
MACHINE_KERNEL_PR = "r1"

KERNEL_IMAGETYPE = "uImage"
KERNEL_IMAGE_SYMLINK_NAME = "${KERNEL_IMAGETYPE}"

UBOOT_MACHINE := "omap4_panda_config"
UBOOT_SUFFIX := "img"
SPL_BINARY := "MLO"

UBOOT_ENTRYPOINT := "0x80008000"
UBOOT_LOADADDRESS := "0x80008000"

EXTRA_IMAGEDEPENDS += "u-boot"
```

## conf/machine/pandaboard.conf
```bitbake
#@TYPE: Machine
#@NAME: Pandaboard
#@DESCRIPTION: Machine configuration for the OMAP4430 Panda

require include/omap4.inc

GUI_MACHINE_CLASS = "bigscreen"

IMAGE_FSTYPES += "tar.gz"

SERIAL_CONSOLE = "115200 ttyO2"

MACHINE_EXTRA_RRECOMMENDS = " kernel-modules uim"
MACHINE_FEATURES = "kernel26 wifi bluetooth alsa apm ext2 screen usbgadget usbhost vfat sgx"

DEFAULTTUNE = "armv7ahf-neon"
```
